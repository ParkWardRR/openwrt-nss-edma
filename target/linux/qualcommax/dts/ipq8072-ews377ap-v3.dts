// SPDX-License-Identifier: GPL-2.0-or-later OR BSD-2-Clause
/*
 * EnGenius EWS377AP v3 — managed AP (ezMaster), product_id 0x011a
 */

#include "ipq8072-engenius-ap-hk07.dtsi"

/ {
	model = "EnGenius EWS377AP v3";
	compatible = "engenius,ews377ap-v3", "qcom,ipq8074";
};

&wifi {
	qcom,ath11k-calibration-variant = "EnGenius-EWS377AP-v3";
};
